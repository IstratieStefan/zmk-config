## config/boards/shields/bento44/Kconfig.defconfig
```kconfig
if SHIELD_BENTO44_LEFT

config ZMK_KEYBOARD_NAME
    default "bento44"

config ZMK_SPLIT_ROLE_CENTRAL
    default y

endif

if SHIELD_BENTO44_LEFT || SHIELD_BENTO44_RIGHT

config ZMK_SPLIT
    default y

endif
```

## config/boards/shields/bento44/Kconfig.shield
```kconfig
config SHIELD_BENTO44_LEFT
    def_bool $(shields_list_contains, bento44_left)

config SHIELD_BENTO44_RIGHT
    def_bool $(shields_list_contains, bento44_right)
```
